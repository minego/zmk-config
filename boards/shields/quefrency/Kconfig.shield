## boards/shields/quefrency/Kconfig.shield
```kconfig
config SHIELD_QUEFRENCY_DONGLE
    def_bool $(shields_list_contains,quefrency_dongle)
```

## boards/shields/wireless_quefrency/Kconfig.shield
```kconfig
config SHIELD_WIRELESS_QUEFRENCY_DONGLE
    def_bool $(shields_list_contains,wireless_quefrency_dongle)
```
